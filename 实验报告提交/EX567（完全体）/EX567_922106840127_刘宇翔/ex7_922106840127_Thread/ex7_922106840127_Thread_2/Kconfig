## 实验报告提交/EX567（完全体）/EX567_922106840127_刘宇翔/ex7_922106840127_Thread/ex7_922106840127_Thread_2/Kconfig
```kconfig
mainmenu "RT-Thread Configuration"

config BSP_DIR
    string
    option env="BSP_ROOT"
    default "."

config RTT_DIR
    string
    option env="RTT_ROOT"
    default "rt-thread"

config PKGS_DIR
    string
    option env="PKGS_ROOT"
    default "packages"

config PLATFORM_DIR
    string
    option env="PLATFORM_DIR"
    default "D:/RT-ThreadStudio/workspace/ex7_922106840127_Tread_2/platform"

source "$RTT_DIR/Kconfig"
source "$PKGS_DIR/Kconfig"
source "$RTT_DIR/../libraries/Kconfig"
```
